## drivers/mfrc522/Kconfig
```kconfig
menuconfig MFRC522
	bool "MFRC522 RFID reader/writer"
	default n
	depends on SPI && GPIO
	help
	  Enable driver for MFRC522 RFID reader/writer.

if MFRC522

config MFRC522_INIT_PRIORITY
	int "MFRC522 devices init priority"
	default 85
	help
	  MFRC522 devices initialization priority.

module = MFRC522
module-str = mfrc522
source "subsys/logging/Kconfig.template.log_config"

endif # MFRC522
```

## dts/bindings/nxp,mfrc522.yaml
```yaml
# MFRC522 RFID reader/writer binding

description: NXP MFRC522 RFID reader/writer

compatible: "nxp,mfrc522"

include: [spi-device.yaml]

properties:
  reset-gpios:
    type: phandle-array
    required: true
    description: |
      GPIO connected to the MFRC522 reset pin.
      Active low (asserting the pin will perform a reset).

  irq-gpios:
    type: phandle-array
    required: false
    description: |
      GPIO connected to the MFRC522 IRQ pin. 
      Optional, can be used for interrupt-driven operation.
```
